## sdkconfig.defaults
```kconfig
CONFIG_ESPTOOLPY_FLASHSIZE_4MB=y
CONFIG_ESPTOOLPY_FLASHSIZE="4MB"
CONFIG_PM_ENABLE=y
CONFIG_PM_DFS_INIT_AUTO=y
CONFIG_ESP_WIFI_ENABLED=n
CONFIG_MQTT_PROTOCOL_311=n
CONFIG_DSP_MAX_FFT_SIZE_256=y
CONFIG_DSP_MAX_FFT_SIZE=256
```
